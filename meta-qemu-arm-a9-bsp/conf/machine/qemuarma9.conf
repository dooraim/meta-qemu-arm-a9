## meta-qemu-arm-a9-bsp/conf/machine/qemuarma9.conf
```bitbake
#@TYPE: Machine
#@NAME: qemuarma9
#@DESCRIPTION: a9 vexpress

require conf/machine/include/qemu.inc
DEFAULTTUNE ?= "armv7at"
require conf/machine/include/tune-cortexa9.inc

SERIAL_CONSOLES ?= "115200;ttyAMA0"

CRIU_BUILD_ARCH = "armv7"

# kernel
KERNEL_IMAGETYPE = "zImage"
KERNEL_DEVICETREE = "vexpress-v2p-ca9.dtb"
KERNEL_DEFCONFIG = "vexpress_defconfig"

# uboot

# Include u-boot
EXTRA_IMAGEDEPENDS += "u-boot"
UBOOT_MACHINE = "vexpress_ca9x4_defconfig"
# Include u-boot elf file in the images folder
UBOOT_ELF = "u-boot"

# Include u-boot default environment file
UBOOT_INITIAL_ENV = "uboot-init.env"
UBOOT_ENV_SIZE = "0x40000"
```

## meta-qemu-arm-a9-distro/conf/layer.conf
```bitbake
# We have a conf and classes directory, add to BBPATH
BBPATH .= ":${LAYERDIR}"

# We have recipes-* directories, add to BBFILES
BBFILES += "${LAYERDIR}/recipes-*/*/*.bb \
            ${LAYERDIR}/recipes-*/*/*.bbappend"

BBFILE_COLLECTIONS += "meta-qemu-arm-a9-distro"
BBFILE_PATTERN_meta-qemu-arm-a9-distro = "^${LAYERDIR}/"
BBFILE_PRIORITY_meta-qemu-arm-a9-distro = "6"

LAYERDEPENDS_meta-qemu-arm-a9-distro = "core"
LAYERSERIES_COMPAT_meta-qemu-arm-a9-distro = "mickledore"
```
